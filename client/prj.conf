## CMakeLists.txt
```
# SPDX-License-Identifier: Apache-2.0

cmake_minimum_required(VERSION 3.20.0)

# Force use of nRF SDK Python - check multiple sources
if(DEFINED WEST_PYTHON)
  set(Python3_EXECUTABLE "${WEST_PYTHON}" CACHE FILEPATH "Python executable" FORCE)
elseif(DEFINED ENV{WEST_PYTHON})
  set(Python3_EXECUTABLE "$ENV{WEST_PYTHON}" CACHE FILEPATH "Python executable" FORCE)
elseif(EXISTS "/opt/nordic/ncs/toolchains/322ac893fe/opt/python@3.12/bin/python3.12")
  # Fallback to known SDK Python location
  set(Python3_EXECUTABLE "/opt/nordic/ncs/toolchains/322ac893fe/opt/python@3.12/bin/python3.12" CACHE FILEPATH "Python executable" FORCE)
endif()

find_package(Zephyr REQUIRED HINTS $ENV{ZEPHYR_BASE})
project(NONE)

target_sources(app PRIVATE
        src/main.c
        src/motion_logic.c
)
```

## prj.conf
```kconfig
# Bluetooth configuration
CONFIG_BT=y
CONFIG_BT_PERIPHERAL=y
CONFIG_BT_DEVICE_NAME="GuitarAcc Guitar"
CONFIG_BT_DEVICE_APPEARANCE=0

# Connection context for managing connections
CONFIG_BT_CONN_CTX=y

# DK Library for LED and button support
CONFIG_DK_LIBRARY=y

# Logging
CONFIG_LOG=y
CONFIG_DEBUG_THREAD_INFO=y

# RTT (SEGGER Real-Time Transfer) for debug output
# TODO: Disable RTT before production shipment for performance/security
CONFIG_USE_SEGGER_RTT=y
CONFIG_RTT_CONSOLE=y
CONFIG_LOG_BACKEND_RTT=y
CONFIG_LOG_BACKEND_UART=n

# Sensor support for ADXL362 accelerometer
CONFIG_SENSOR=y
CONFIG_SENSOR_LOG_LEVEL_DBG=y
CONFIG_ADXL362_ACCEL_RANGE_2G=y

# ADXL362 Hardware Wake-on-Motion (Interrupt-driven)
# Use INT1 pin for motion interrupts
CONFIG_ADXL362_INTERRUPT_MODE=1
# 500mg = 0.5g motion threshold
CONFIG_ADXL362_ACTIVITY_THRESHOLD=500
# 5 samples at ODR for inactivity detection
CONFIG_ADXL362_INACTIVITY_TIME=5

# GPIO for interrupt handling
CONFIG_GPIO=y

# Power management
CONFIG_PM_DEVICE=y
CONFIG_PM_DEVICE_RUNTIME=y

# Bootloader support
CONFIG_PARTITION_MANAGER_ENABLED=y
CONFIG_MCUBOOT_APPLICATION_IMAGE_NUMBER=0
CONFIG_MCUBOOT_NETWORK_CORE_IMAGE_NUMBER=1
CONFIG_MCUBOOT_SIGNATURE_KEY_FILE="/opt/nordic/ncs/v3.2.1/bootloader/mcuboot/root-rsa-2048.pem"
CONFIG_MCUBOOT_BOOTLOADER_MODE_OVERWRITE_ONLY=y
CONFIG_ROM_END_OFFSET=0x180
```

## src/main.c
```c
/*
 * Copyright (c) 2026 GuitarAcc Project
 * SPDX-License-Identifier: Apache-2.0
 */

#include <zephyr/types.h>
#include <stddef.h>
#include <string.h>
#include <errno.h>
#include <zephyr/sys/printk.h>
#include <zephyr/sys/byteorder.h>
#include <zephyr/kernel.h>
#include <zephyr/logging/log.h>
#include <zephyr/drivers/gpio.h>

#include <soc.h>
#include <assert.h>

#include <zephyr/settings/settings.h>

#include <zephyr/bluetooth/bluetooth.h>
#include <zephyr/bluetooth/hci.h>
#include <zephyr/bluetooth/conn.h>
#include <zephyr/bluetooth/uuid.h>
#include <zephyr/bluetooth/gatt.h>

#include <dk_buttons_and_leds.h>
#include <zephyr/device.h>
#include <zephyr/drivers/sensor.h>
// COMMENTED OUT FOR TROUBLESHOOTING
// #include <zephyr/pm/device.h>
#include <math.h>
#include "motion_logic.h"

LOG_MODULE_REGISTER(guitar, LOG_LEVEL_DBG);

/* ========== DEFINES ========== */

/* Enable test mode to generate incrementing accelerometer data */
//#define TEST_MODE_ENABLED 1

#define DEVICE_NAME     CONFIG_BT_DEVICE_NAME
#define DEVICE_NAME_LEN (sizeof(DEVICE_NAME) - 1)

#define RUN_STATUS_LED          DK_LED1
#define CON_STATUS_LED          DK_LED2
#define USER_BUTTON             DK_BTN1_MSK

#define MOVEMENT_THRESHOLD_MILLI_G  50  /* Minimum change to transmit (0.05g) */

#define ACCEL_ALIAS DT_ALIAS(accel0)
// COMMENTED OUT FOR TROUBLESHOOTING
// #define MOTION_TIMEOUT_MS 30000  /* 30 seconds of inactivity before sleep */

/* Custom Guitar Service UUID: a7c8f9d2-4b3e-4a1d-9f2c-8e7d6c5b4a3f */
#define BT_UUID_GUITAR_SERVICE_VAL \
	BT_UUID_128_ENCODE(0xa7c8f9d2, 0x4b3e, 0x4a1d, 0x9f2c, 0x8e7d6c5b4a3f)

/* Acceleration Data Characteristic UUID: a7c8f9d2-4b3e-4a1d-9f2c-8e7d6c5b4a40 */
#define BT_UUID_GUITAR_ACCEL_CHAR_VAL \
	BT_UUID_128_ENCODE(0xa7c8f9d2, 0x4b3e, 0x4a1d, 0x9f2c, 0x8e7d6c5b4a40)

/* ========== STATIC VARIABLES ========== */

#if !TEST_MODE_ENABLED
static const struct device *accel_dev = DEVICE_DT_GET(ACCEL_ALIAS);
#endif

// COMMENTED OUT FOR TROUBLESHOOTING
// static struct k_timer motion_timer;
// static bool is_sleeping = false;
static bool is_connected = false;
static bool is_advertising = false;
static bool transmission_enabled = true; /* Button toggles this */

#if !TEST_MODE_ENABLED
/* GPIO interrupt for accelerometer motion detection */
static struct gpio_callback accel_cb_data;
#endif

#if TEST_MODE_ENABLED
static int16_t test_counter = 0;
#endif

static struct bt_uuid_128 guitar_service_uuid = BT_UUID_INIT_128(
	BT_UUID_GUITAR_SERVICE_VAL);

static struct bt_uuid_128 guitar_accel_char_uuid = BT_UUID_INIT_128(
	BT_UUID_GUITAR_ACCEL_CHAR_VAL);

static struct accel_data current_accel;
static struct accel_data previous_accel;
static bool accel_notify_enabled = false;

/* ========== ADVERTISING DATA ========== */
#if CONFIG_BT_DIRECTED_ADVERTISING
/* Bonded address queue. */
K_MSGQ_DEFINE(bonds_queue,
	      sizeof(bt_addr_le_t),
	      CONFIG_BT_MAX_PAIRED,
	      4);
#endif

static const struct bt_data ad[] = {
	BT_DATA_BYTES(BT_DATA_FLAGS, (BT_LE_AD_GENERAL | BT_LE_AD_NO_BREDR)),
	BT_DATA_BYTES(BT_DATA_GAP_APPEARANCE,
		      (CONFIG_BT_DEVICE_APPEARANCE >> 0) & 0xff,
		      (CONFIG_BT_DEVICE_APPEARANCE >> 8) & 0xff),
	BT_DATA(BT_DATA_UUID128_ALL, guitar_service_uuid.val, sizeof(guitar_service_uuid.val)),
};

static const struct bt_data sd[] = {
	BT_DATA(BT_DATA_NAME_COMPLETE, DEVICE_NAME, DEVICE_NAME_LEN),
};

/* ========== HELPER FUNCTIONS ========== */

// COMMENTED OUT FOR TROUBLESHOOTING
// static void motion_timeout_handler(struct k_timer *timer)
// {
// 	if (!is_connected) {
// 		LOG_INF("No motion detected, entering sleep mode");
// 		is_sleeping = true;
// 		bt_le_adv_stop();
// #if !TEST_MODE_ENABLED
// 		/* Put accelerometer in motion detection mode with lower power */
// 		pm_device_action_run(accel_dev, PM_DEVICE_ACTION_SUSPEND);
// #endif
// 	}
// }
//
// static void wake_from_motion(void)
// {
// 	if (is_sleeping) {
// 		LOG_INF("Motion detected, waking up");
// 		is_sleeping = false;
// #if !TEST_MODE_ENABLED
// 		/* Wake up accelerometer */
// 		pm_device_action_run(accel_dev, PM_DEVICE_ACTION_RESUME);
// #endif
// 		/* Restart advertising */
// 		bt_le_adv_start(BT_LE_ADV_CONN_FAST_1, ad, ARRAY_SIZE(ad), NULL, 0);
// 	}
// 	/* Reset inactivity timer */
// 	k_timer_start(&motion_timer, K_MSEC(MOTION_TIMEOUT_MS), K_NO_WAIT);
// }

/* ========== LED BLINK THREAD ========== */

#define LED_BLINK_INTERVAL_MS 500  /* 1Hz blink: 500ms on, 500ms off */
#define BLUE_LED DK_LED3  /* Blue component for Thingy:53 RGB LED */

static void led_blink_thread_fn(void *arg1, void *arg2, void *arg3)
{
	ARG_UNUSED(arg1);
	ARG_UNUSED(arg2);
	ARG_UNUSED(arg3);

	bool led_state = false;

	while (1) {
		if (is_advertising && !is_connected) {
			/* Blue blink when advertising but not connected */
			led_state = !led_state;
			dk_set_led(BLUE_LED, led_state);
			k_msleep(LED_BLINK_INTERVAL_MS);
		} else if (is_connected && !transmission_enabled) {
			/* Green blink when connected but transmission disabled */
			led_state = !led_state;
			dk_set_led(CON_STATUS_LED, led_state);
			k_msleep(LED_BLINK_INTERVAL_MS);
		} else {
			/* Solid state handled by connection callbacks */
			k_msleep(100);
		}
	}
}

K_THREAD_STACK_DEFINE(led_blink_stack, 512);
static struct k_thread led_blink_thread;

/* ========== BUTTON HANDLER ========== */

static void button_changed(uint32_t button_state, uint32_t has_changed)
{
	if (has_changed & USER_BUTTON) {
		if (button_state & USER_BUTTON) {
			/* Button pressed - toggle transmission */
			transmission_enabled = !transmission_enabled;
			LOG_INF("Button pressed: Transmission %s", 
			        transmission_enabled ? "ENABLED" : "DISABLED");
			
			/* Update LED immediately if connected */
			if (is_connected) {
				if (transmission_enabled) {
					/* Solid green for transmitting */
					dk_set_led_on(CON_STATUS_LED);
				}
				/* Blink thread will handle blinking state */
			}
		}
	}
}

static int init_button(void)
{
	int err = dk_buttons_init(button_changed);
	if (err) {
		LOG_ERR("Cannot init buttons (err: %d)", err);
	}
	return err;
}

/* ========== ACCELEROMETER INTERRUPT ========== */

#if !TEST_MODE_ENABLED
static void accel_gpio_handler(const struct device *dev,
                               struct gpio_callback *cb,
                               uint32_t pins)
{
	LOG_INF("*** MOTION INTERRUPT DETECTED *** (GPIO pins: 0x%08x)", pins);
	/* TODO: When sleep mode is implemented, call wake_from_motion() here */
	// wake_from_motion();
}
#endif

/* ========== CONNECTION CALLBACKS ========== */

static void connected(struct bt_conn *conn, uint8_t err)
{
	if (err) {
		LOG_ERR("Connection failed (err 0x%02x)", err);
	} else {
		LOG_INF("Connected");
		is_connected = true;
		is_advertising = false;  /* Stop advertising state */
		dk_set_led_off(BLUE_LED);  /* Turn off blue LED */
		/* LED: Solid green if transmitting, blink green if paused */
		if (transmission_enabled) {
			dk_set_led_on(CON_STATUS_LED);
		}
		/* Blink thread handles blinking when transmission_enabled=false */
		// COMMENTED OUT FOR TROUBLESHOOTING
		// k_timer_stop(&motion_timer);
	}
}

static void disconnected(struct bt_conn *conn, uint8_t reason)
{
	LOG_INF("Disconnected (reason 0x%02x)", reason);
	is_connected = false;
	dk_set_led_off(CON_STATUS_LED); /* Turn off green LED */
	dk_set_led_off(BLUE_LED); /* Turn off blue LED */
	accel_notify_enabled = false;
	// COMMENTED OUT FOR TROUBLESHOOTING
	// k_timer_start(&motion_timer, K_MSEC(MOTION_TIMEOUT_MS), K_NO_WAIT);
}

static void recycled_cb(void)
{
	LOG_INF("Connection recycled, restarting advertising");
	/* Restart advertising after connection object is recycled */
	int err = bt_le_adv_start(BT_LE_ADV_CONN_FAST_2, ad, ARRAY_SIZE(ad), sd, ARRAY_SIZE(sd));
	if (err) {
		LOG_ERR("Advertising failed to start (err %d)", err);
	} else {
		is_advertising = true;
	}
}

#ifdef CONFIG_BT_SMP
static void security_changed(struct bt_conn *conn, bt_security_t level,
			     enum bt_security_err err)
{
	char addr[BT_ADDR_LE_STR_LEN];

	bt_addr_le_to_str(bt_conn_get_dst(conn), addr, sizeof(addr));

	if (!err) {
		LOG_INF("Security changed: %s level %u", addr, level);
	} else {
		LOG_ERR("Security failed: %s level %u err %d", addr, level, err);
	}
}
#endif

BT_CONN_CB_DEFINE(conn_callbacks) = {
	.connected = connected,
	.disconnected = disconnected,
	.recycled = recycled_cb,
#ifdef CONFIG_BT_SMP
	.security_changed = security_changed,
#endif
};

/* ========== AUTHENTICATION CALLBACKS ========== */

#if defined(CONFIG_BT_SMP)
static void auth_passkey_display(struct bt_conn *conn, unsigned int passkey)
{
	char addr[BT_ADDR_LE_STR_LEN];

	bt_addr_le_to_str(bt_conn_get_dst(conn), addr, sizeof(addr));

	LOG_INF("Passkey for %s: %06u", addr, passkey);
}

static void auth_cancel(struct bt_conn *conn)
{
	char addr[BT_ADDR_LE_STR_LEN];

	bt_addr_le_to_str(bt_conn_get_dst(conn), addr, sizeof(addr));

	LOG_INF("Pairing cancelled: %s", addr);
}

static void pairing_complete(struct bt_conn *conn, bool bonded)
{
	char addr[BT_ADDR_LE_STR_LEN];

	bt_addr_le_to_str(bt_conn_get_dst(conn), addr, sizeof(addr));

	LOG_INF("Pairing completed: %s, bonded: %d", addr, bonded);
}

static void pairing_failed(struct bt_conn *conn, enum bt_security_err reason)
{
	char addr[BT_ADDR_LE_STR_LEN];

	bt_addr_le_to_str(bt_conn_get_dst(conn), addr, sizeof(addr));

	LOG_ERR("Pairing failed conn: %s, reason %d", addr, reason);
}

static struct bt_conn_auth_cb conn_auth_callbacks = {
	.passkey_display = auth_passkey_display,
	.cancel = auth_cancel,
};

static struct bt_conn_auth_info_cb conn_auth_info_callbacks = {
	.pairing_complete = pairing_complete,
	.pairing_failed = pairing_failed
};
#else
static struct bt_conn_auth_cb conn_auth_callbacks;
static struct bt_conn_auth_info_cb conn_auth_info_callbacks;
#endif

/* ========== GATT CALLBACKS ========== */

static void accel_ccc_cfg_changed(const struct bt_gatt_attr *attr, uint16_t value)
{
	accel_notify_enabled = (value == BT_GATT_CCC_NOTIFY);
	LOG_INF("Acceleration notifications %s", accel_notify_enabled ? "enabled" : "disabled");
}

/* ========== GATT SERVICE DEFINITION ========== */

/* Guitar GATT Service Definition */
BT_GATT_SERVICE_DEFINE(guitar_svc,
	BT_GATT_PRIMARY_SERVICE(&guitar_service_uuid),
	BT_GATT_CHARACTERISTIC(&guitar_accel_char_uuid.uuid,
			       BT_GATT_CHRC_NOTIFY,
			       BT_GATT_PERM_NONE,
			       NULL, NULL, NULL),
	BT_GATT_CCC(accel_ccc_cfg_changed,
		    BT_GATT_PERM_READ | BT_GATT_PERM_WRITE),
);

/* ========== DATA SENDING FUNCTIONS ========== */

static int send_accel_notification(struct bt_conn *conn)
{
	int err;
	
	if (!accel_notify_enabled || !transmission_enabled) {
		return 0;
	}

	/* Only send if movement exceeds threshold (filter minor changes/noise) */
	if (!detect_movement_threshold(&current_accel, &previous_accel, MOVEMENT_THRESHOLD_MILLI_G)) {
		return 0;
	}

	err = bt_gatt_notify(conn, &guitar_svc.attrs[1], &current_accel, sizeof(current_accel));
	if (err) {
		LOG_ERR("Failed to send notification (err %d)", err);
		return err;
	}

	/* Update previous values after successful send */
	previous_accel = current_accel;
	
	LOG_DBG("Sent accel: X=%d, Y=%d, Z=%d milli-g", 
		current_accel.x, current_accel.y, current_accel.z);

	return 0;
}

/* ========== MAIN FUNCTION ========== */

int main(void)
{
	int err;
	struct sensor_value accel[3];

	LOG_INF("BLE Peripheral starting (simplified for troubleshooting)...");

#if TEST_MODE_ENABLED
	LOG_INF("Running in TEST MODE - no accelerometer required");
#else
	/* Initialize accelerometer */
	if (!device_is_ready(accel_dev)) {
		LOG_ERR("Accelerometer device not ready");
		return 0;
	}
	LOG_INF("Accelerometer initialized");

	/* Configure GPIO interrupt for ADXL362 INT1 pin */
	const struct gpio_dt_spec int1_gpio = GPIO_DT_SPEC_GET_BY_IDX(DT_ALIAS(accel0), int1_gpios, 0);
	
	if (!gpio_is_ready_dt(&int1_gpio)) {
		LOG_ERR("INT1 GPIO not ready");
		return 0;
	}
	
	err = gpio_pin_configure_dt(&int1_gpio, GPIO_INPUT);
	if (err) {
		LOG_ERR("Failed to configure INT1 as input (err %d)", err);
		return 0;
	}
	
	err = gpio_pin_interrupt_configure_dt(&int1_gpio, GPIO_INT_EDGE_RISING);
	if (err) {
		LOG_ERR("Failed to configure interrupt (err %d)", err);
		return 0;
	}
	
	gpio_init_callback(&accel_cb_data, accel_gpio_handler, BIT(int1_gpio.pin));
	err = gpio_add_callback(int1_gpio.port, &accel_cb_data);
	if (err) {
		LOG_ERR("Failed to add callback (err %d)", err);
		return 0;
	}
	
	LOG_INF("ADXL362 motion interrupt enabled on GPIO0.%d (threshold: 500mg)", int1_gpio.pin);
#endif

	// COMMENTED OUT FOR TROUBLESHOOTING
	// /* Initialize motion timer */
	// k_timer_init(&motion_timer, motion_timeout_handler, NULL);

	/* Initialize LEDs and buttons */
	err = dk_leds_init();
	if (err) {
		LOG_ERR("LEDs init failed (err %d)", err);
		return 0;
	}

	err = init_button();
	if (err) {
		LOG_ERR("Button init failed (err %d)", err);
		return 0;
	}

	/* Start LED blink thread for "connected but not transmitting" indication */
	k_thread_create(&led_blink_thread, led_blink_stack,
	                K_THREAD_STACK_SIZEOF(led_blink_stack),
	                led_blink_thread_fn, NULL, NULL, NULL,
	                7, 0, K_NO_WAIT);
	k_thread_name_set(&led_blink_thread, "led_blink");

	/* Register authentication callbacks */

	if (IS_ENABLED(CONFIG_BT_SMP)) {
		err = bt_conn_auth_cb_register(&conn_auth_callbacks);
		if (err) {
			LOG_ERR("Failed to register authorization callbacks (err %d)", err);
			return 0;
		}

		err = bt_conn_auth_info_cb_register(&conn_auth_info_callbacks);
		if (err) {
			LOG_ERR("Failed to register authorization info callbacks (err %d)", err);
			return 0;
		}
	}

	err = bt_enable(NULL);
	if (err) {
		LOG_ERR("Bluetooth init failed (err %d)", err);
		return 0;
	}

	LOG_INF("Bluetooth initialized");

	/* Load settings from persistent storage */
	if (IS_ENABLED(CONFIG_SETTINGS)) {
		settings_load();
	}

	err = bt_le_adv_start(BT_LE_ADV_CONN_FAST_2, ad, ARRAY_SIZE(ad), sd, ARRAY_SIZE(sd));
	if (err) {
		LOG_ERR("Advertising failed to start (err %d)", err);
		return 0;
	}

	is_advertising = true;
	LOG_INF("Advertising successfully started, device name: %s", DEVICE_NAME);

	/* Initialize spike limiter with zero values */
	spike_limiter_init(NULL);
	LOG_INF("Spike limiter initialized (limit: %d milli-g)", SPIKE_LIMIT_MILLI_G);

#if ENABLE_RUNNING_AVERAGE
	/* Initialize running average filter */
	running_average_init();
	LOG_INF("Running average filter initialized (depth: %d)", RUNNING_AVERAGE_DEPTH);
#else
	LOG_INF("Running average filter disabled");
#endif

	// COMMENTED OUT FOR TROUBLESHOOTING
	// k_timer_start(&motion_timer, K_MSEC(MOTION_TIMEOUT_MS), K_NO_WAIT);

	/* Main loop: Generate test data and send notifications */
	LOG_INF("Entering main loop (TEST_MODE enabled)...");
	while (1) {
#if TEST_MODE_ENABLED
		/* Generate synthetic incrementing test data */
		current_accel.x = test_counter;
		current_accel.y = test_counter + 100;
		current_accel.z = test_counter + 200;
		
		test_counter += 10;
		if (test_counter > 1000) {
			test_counter = 0;
		}
		
		/* Send notification if connected and enabled */
		if (is_connected) {
			bt_conn_foreach(BT_CONN_TYPE_LE, 
				       (void (*)(struct bt_conn *, void *))send_accel_notification,
				       NULL);
		}
		
		k_sleep(K_MSEC(100)); /* 10Hz update rate */
#else
		/* Read accelerometer and send notifications */
		err = sensor_sample_fetch(accel_dev);
		if (err == 0) {
			struct accel_data raw_accel, filtered_accel;
			
			sensor_channel_get(accel_dev, SENSOR_CHAN_ACCEL_XYZ, accel);
			
			/* Get acceleration values in m/s² */
			double x = sensor_value_to_double(&accel[0]);
			double y = sensor_value_to_double(&accel[1]);
			double z = sensor_value_to_double(&accel[2]);
			
			/* Convert to milli-g */
			convert_accel_to_milli_g(x, y, z, &raw_accel);
			
			/* Apply spike limiter */
			apply_spike_limiter(&raw_accel, &filtered_accel);
			
#if ENABLE_RUNNING_AVERAGE
			/* Apply running average filter */
			apply_running_average(&filtered_accel, &current_accel);
#else
			/* No running average - use spike-limited data directly */
			current_accel = filtered_accel;
#endif
			
			/* Send notification if connected and enabled (only if data changed) */
			if (is_connected) {
				bt_conn_foreach(BT_CONN_TYPE_LE, 
					       (void (*)(struct bt_conn *, void *))send_accel_notification,
					       NULL);
			}
		} else {
			LOG_ERR("Failed to fetch sensor sample (err %d)", err);
		}
		
		k_sleep(K_MSEC(100)); /* 10Hz sample rate */
#endif
	}

	return 0;
}
```

## src/main2.c
```c
/*
 * Copyright (c) 2026 GuitarAcc Project
 * SPDX-License-Identifier: Apache-2.0
 */

#include <zephyr/types.h>
#include <stddef.h>
#include <string.h>
#include <errno.h>
#include <zephyr/sys/printk.h>
#include <zephyr/sys/byteorder.h>
#include <zephyr/kernel.h>
#include <zephyr/logging/log.h>
#include <zephyr/drivers/gpio.h>

#include <soc.h>
#include <assert.h>

#include <zephyr/settings/settings.h>

#include <zephyr/bluetooth/bluetooth.h>
#include <zephyr/bluetooth/hci.h>
#include <zephyr/bluetooth/conn.h>
#include <zephyr/bluetooth/uuid.h>
#include <zephyr/bluetooth/gatt.h>
#include <zephyr/device.h>
#include <zephyr/drivers/sensor.h>
#include <zephyr/pm/device.h>
#include <math.h>
#include "motion_logic.h"

LOG_MODULE_REGISTER(guitar, LOG_LEVEL_DBG);

/* ========== DEFINES ========== */

/* Enable test mode to generate incrementing accelerometer data */
//#define TEST_MODE_ENABLED 1

#define DEVICE_NAME     CONFIG_BT_DEVICE_NAME
#define DEVICE_NAME_LEN (sizeof(DEVICE_NAME) - 1)

#define ACCEL_ALIAS DT_ALIAS(accel0)
#define MOTION_TIMEOUT_MS 30000  /* 30 seconds of inactivity before sleep */

/* Custom Guitar Service UUID: a7c8f9d2-4b3e-4a1d-9f2c-8e7d6c5b4a3f */
#define BT_UUID_GUITAR_SERVICE_VAL \
	BT_UUID_128_ENCODE(0xa7c8f9d2, 0x4b3e, 0x4a1d, 0x9f2c, 0x8e7d6c5b4a3f)

/* Acceleration Data Characteristic UUID: a7c8f9d2-4b3e-4a1d-9f2c-8e7d6c5b4a40 */
#define BT_UUID_GUITAR_ACCEL_CHAR_VAL \
	BT_UUID_128_ENCODE(0xa7c8f9d2, 0x4b3e, 0x4a1d, 0x9f2c, 0x8e7d6c5b4a40)

/* ========== STATIC VARIABLES ========== */

#if !TEST_MODE_ENABLED
static const struct device *accel_dev = DEVICE_DT_GET(ACCEL_ALIAS);
#endif

static struct k_timer motion_timer;
static bool is_sleeping = false;
static bool is_connected = false;

#if TEST_MODE_ENABLED
static int16_t test_counter = 0;
#endif

static struct bt_uuid_128 guitar_service_uuid = BT_UUID_INIT_128(
	BT_UUID_GUITAR_SERVICE_VAL);

static struct bt_uuid_128 guitar_accel_char_uuid = BT_UUID_INIT_128(
	BT_UUID_GUITAR_ACCEL_CHAR_VAL);

static struct accel_data current_accel;
static struct accel_data previous_accel;
static bool accel_notify_enabled = false;

/* ========== ADVERTISING DATA ========== */
#if CONFIG_BT_DIRECTED_ADVERTISING
/* Bonded address queue. */
K_MSGQ_DEFINE(bonds_queue,
	      sizeof(bt_addr_le_t),
	      CONFIG_BT_MAX_PAIRED,
	      4);
#endif

static const struct bt_data ad[] = {
	BT_DATA_BYTES(BT_DATA_GAP_APPEARANCE,
		      (CONFIG_BT_DEVICE_APPEARANCE >> 0) & 0xff,
		      (CONFIG_BT_DEVICE_APPEARANCE >> 8) & 0xff),
	BT_DATA_BYTES(BT_DATA_FLAGS, (BT_LE_AD_GENERAL | BT_LE_AD_NO_BREDR)),
	BT_DATA(BT_DATA_UUID128_ALL, guitar_service_uuid.val, sizeof(guitar_service_uuid.val)),
};

static const struct bt_data sd[] = {
	BT_DATA(BT_DATA_NAME_COMPLETE, DEVICE_NAME, DEVICE_NAME_LEN),
};

/* ========== HELPER FUNCTIONS ========== */

static void motion_timeout_handler(struct k_timer *timer)
{
	if (!is_connected) {
		LOG_INF("No motion detected, entering sleep mode");
		is_sleeping = true;
		bt_le_adv_stop();
#if !TEST_MODE_ENABLED
		/* Put accelerometer in motion detection mode with lower power */
		pm_device_action_run(accel_dev, PM_DEVICE_ACTION_SUSPEND);
#endif
	}
}

static void wake_from_motion(void)
{
	if (is_sleeping) {
		LOG_INF("Motion detected, waking up");
		is_sleeping = false;
#if !TEST_MODE_ENABLED
		/* Wake up accelerometer */
		pm_device_action_run(accel_dev, PM_DEVICE_ACTION_RESUME);
#endif
		/* Restart advertising */
		bt_le_adv_start(BT_LE_ADV_CONN_FAST_1, ad, ARRAY_SIZE(ad), sd, ARRAY_SIZE(sd));
	}
	/* Reset inactivity timer */
	k_timer_start(&motion_timer, K_MSEC(MOTION_TIMEOUT_MS), K_NO_WAIT);
}

/* ========== CONNECTION CALLBACKS ========== */

static void connected(struct bt_conn *conn, uint8_t err)
{
	if (err) {
		LOG_ERR("Connection failed (err 0x%02x)", err);
	} else {
		LOG_INF("Connected to basestation");
		is_connected = true;
		k_timer_stop(&motion_timer);
	}
}

static void disconnected(struct bt_conn *conn, uint8_t reason)
{
	LOG_INF("Disconnected from basestation (reason 0x%02x)", reason);
	is_connected = false;
	accel_notify_enabled = false;
	/* Restart motion monitoring */
	k_timer_start(&motion_timer, K_MSEC(MOTION_TIMEOUT_MS), K_NO_WAIT);
}

BT_CONN_CB_DEFINE(conn_callbacks) = {
	.connected = connected,
	.disconnected = disconnected,
};

/* ========== GATT CALLBACKS ========== */

static void accel_ccc_cfg_changed(const struct bt_gatt_attr *attr, uint16_t value)
{
	accel_notify_enabled = (value == BT_GATT_CCC_NOTIFY);
	LOG_INF("Acceleration notifications %s", accel_notify_enabled ? "enabled" : "disabled");
}

/* ========== GATT SERVICE DEFINITION ========== */

/* Guitar GATT Service Definition */
BT_GATT_SERVICE_DEFINE(guitar_svc,
	BT_GATT_PRIMARY_SERVICE(&guitar_service_uuid),
	BT_GATT_CHARACTERISTIC(&guitar_accel_char_uuid.uuid,
			       BT_GATT_CHRC_NOTIFY,
			       BT_GATT_PERM_NONE,
			       NULL, NULL, NULL),
	BT_GATT_CCC(accel_ccc_cfg_changed,
		    BT_GATT_PERM_READ | BT_GATT_PERM_WRITE),
);

/* ========== DATA SENDING FUNCTIONS ========== */

/* ========== DATA SENDING FUNCTIONS ========== */

static int send_accel_notification(struct bt_conn *conn)
{
	int err;
	
	if (!accel_notify_enabled) {
		return 0;
	}

	/* Only send if data has changed (power optimization) */
	if (!accel_data_changed(&current_accel, &previous_accel)) {
		return 0;
	}

	err = bt_gatt_notify(conn, &guitar_svc.attrs[1], &current_accel, sizeof(current_accel));
	if (err) {
		LOG_ERR("Failed to send notification (err %d)", err);
		return err;
	}

	/* Update previous values after successful send */
	previous_accel = current_accel;
	
	LOG_DBG("Sent accel: X=%d, Y=%d, Z=%d milli-g", 
		current_accel.x, current_accel.y, current_accel.z);

	return 0;
}

/* ========== MAIN FUNCTION ========== */

int main(void)
{
	int err;
	struct sensor_value accel[3];

	LOG_INF("GuitarAcc Guitar (Peripheral) starting...");

#if TEST_MODE_ENABLED
	LOG_INF("Running in TEST MODE - no accelerometer required");
#else
	/* Initialize accelerometer */
	if (!device_is_ready(accel_dev)) {
		LOG_ERR("Accelerometer device not ready");
		return 0;
	}
	LOG_INF("Accelerometer initialized");
#endif

	/* Initialize motion timer */
	k_timer_init(&motion_timer, motion_timeout_handler, NULL);

	err = bt_enable(NULL);
	if (err) {
		LOG_ERR("Bluetooth init failed (err %d)", err);
		return 0;
	}

	LOG_INF("Bluetooth initialized");

	err = bt_le_adv_start(BT_LE_ADV_CONN_FAST_1, ad, ARRAY_SIZE(ad), sd, ARRAY_SIZE(sd));
	if (err) {
		LOG_ERR("Advertising failed to start (err %d)", err);
		return 0;
	}

	LOG_INF("Advertising as guitar, waiting for basestation...");

	/* Start motion monitoring */
	k_timer_start(&motion_timer, K_MSEC(MOTION_TIMEOUT_MS), K_NO_WAIT);

	/* Main loop: monitor accelerometer for motion */
	while (1) {
		k_sleep(K_SECONDS(1));
		
	}
// 	while (1) {
// 		if (!is_sleeping) {
// #if TEST_MODE_ENABLED
// 			/* Test mode: generate incrementing data */
// 			current_accel.x = test_counter;
// 			current_accel.y = test_counter + 100;
// 			current_accel.z = test_counter + 200;
// 			test_counter += 10;
// 			if (test_counter > 1000) {
// 				test_counter = 0;
// 			}
			
// 			LOG_INF("Test mode: Generated accel X=%d, Y=%d, Z=%d", 
// 				current_accel.x, current_accel.y, current_accel.z);
			
// 			/* Test mode: use incrementing data */
// #else
// 			err = sensor_sample_fetch(accel_dev);
// 			if (err == 0) {
// 				sensor_channel_get(accel_dev, SENSOR_CHAN_ACCEL_XYZ, accel);
				
// 				/* Get acceleration values */
// 				double x = sensor_value_to_double(&accel[0]);
// 				double y = sensor_value_to_double(&accel[1]);
// 				double z = sensor_value_to_double(&accel[2]);
				
// 				/* Convert to milli-g and store */
// 				convert_accel_to_milli_g(x, y, z, &current_accel);
// #endif
// 				/* Send notification if connected (only if data changed) */
// 				if (is_connected) {
// 					bt_conn_foreach(BT_CONN_TYPE_LE, 
// 						       (void (*)(struct bt_conn *, void *))send_accel_notification,
// 						       NULL);
// 				}
				
// #ifndef TEST_MODE_ENABLED
// 				/* Detect motion using motion_logic */
// 				if (detect_motion(x, y, z)) {
// 					/* Reset timer on motion */
// 					k_timer_start(&motion_timer, K_MSEC(MOTION_TIMEOUT_MS), K_NO_WAIT);
// 				}
// 			}
// #endif
// 			k_sleep(K_MSEC(100)); /* Sample at 10Hz */
// 		} else {
// #if !TEST_MODE_ENABLED
// 			/* In sleep mode, poll for wake */
// 			err = sensor_sample_fetch(accel_dev);
// 			if (err == 0) {
// 				sensor_channel_get(accel_dev, SENSOR_CHAN_ACCEL_XYZ, accel);
// 				double x = sensor_value_to_double(&accel[0]);
// 				double y = sensor_value_to_double(&accel[1]);
// 				double z = sensor_value_to_double(&accel[2]);
				
// 				if (detect_motion(x, y, z)) {
// 					wake_from_motion();
// 				}
// 			}
// 			k_sleep(K_MSEC(500)); /* Check less frequently in sleep */
// #else
// 			/* Test mode: no sleep polling needed */
// 			k_sleep(K_MSEC(500));
// #endif
// 		}
// 	}

	return 0;
}
```

## src/motion_logic.c
```c
/*
 * Copyright (c) 2026 GuitarAcc Project
 * SPDX-License-Identifier: Apache-2.0
 */

#include "motion_logic.h"
#include <math.h>
#include <stdint.h>
#include <stdbool.h>
#include <stddef.h>  /* for NULL */

/* Gravitational constant in m/s² */
#define GRAVITY 9.81

/* Maximum and minimum values for int16_t */
#define INT16_MAX_VAL 32767
#define INT16_MIN_VAL -32768

/* ========== SPIKE LIMITER ========== */

/* Previous values for spike limiting */
static struct accel_data spike_limiter_prev = {0, 0, 0};

/* Helper function to clamp a value within a range */
static int16_t clamp_int16(int32_t value)
{
	if (value > INT16_MAX_VAL) {
		return INT16_MAX_VAL;
	} else if (value < INT16_MIN_VAL) {
		return INT16_MIN_VAL;
	}
	return (int16_t)value;
}

void spike_limiter_init(const struct accel_data *initial)
{
	if (initial != NULL) {
		spike_limiter_prev = *initial;
	} else {
		spike_limiter_prev.x = 0;
		spike_limiter_prev.y = 0;
		spike_limiter_prev.z = 0;
	}
}

void apply_spike_limiter(const struct accel_data *raw, struct accel_data *limited)
{
	if (raw == NULL || limited == NULL) {
		return;
	}

	/* Calculate change for each axis */
	int32_t dx = (int32_t)raw->x - (int32_t)spike_limiter_prev.x;
	int32_t dy = (int32_t)raw->y - (int32_t)spike_limiter_prev.y;
	int32_t dz = (int32_t)raw->z - (int32_t)spike_limiter_prev.z;

	/* Limit change to SPIKE_LIMIT_MILLI_G */
	if (dx > SPIKE_LIMIT_MILLI_G) dx = SPIKE_LIMIT_MILLI_G;
	if (dx < -SPIKE_LIMIT_MILLI_G) dx = -SPIKE_LIMIT_MILLI_G;
	
	if (dy > SPIKE_LIMIT_MILLI_G) dy = SPIKE_LIMIT_MILLI_G;
	if (dy < -SPIKE_LIMIT_MILLI_G) dy = -SPIKE_LIMIT_MILLI_G;
	
	if (dz > SPIKE_LIMIT_MILLI_G) dz = SPIKE_LIMIT_MILLI_G;
	if (dz < -SPIKE_LIMIT_MILLI_G) dz = -SPIKE_LIMIT_MILLI_G;

	/* Apply limited change */
	limited->x = clamp_int16((int32_t)spike_limiter_prev.x + dx);
	limited->y = clamp_int16((int32_t)spike_limiter_prev.y + dy);
	limited->z = clamp_int16((int32_t)spike_limiter_prev.z + dz);

	/* Update previous values */
	spike_limiter_prev = *limited;
}

/* ========== RUNNING AVERAGE ========== */

#if ENABLE_RUNNING_AVERAGE

/* Ensure depth is within valid range (3-10) */
#if RUNNING_AVERAGE_DEPTH < 3
#undef RUNNING_AVERAGE_DEPTH
#define RUNNING_AVERAGE_DEPTH 3
#elif RUNNING_AVERAGE_DEPTH > 10
#undef RUNNING_AVERAGE_DEPTH
#define RUNNING_AVERAGE_DEPTH 10
#endif

/* Circular buffers for each axis */
static int16_t buffer_x[RUNNING_AVERAGE_DEPTH];
static int16_t buffer_y[RUNNING_AVERAGE_DEPTH];
static int16_t buffer_z[RUNNING_AVERAGE_DEPTH];

/* Buffer state */
static uint8_t buffer_index = 0;
static uint8_t buffer_count = 0;  /* Number of valid samples in buffer */

void running_average_init(void)
{
	buffer_index = 0;
	buffer_count = 0;
	
	/* Clear buffers */
	for (uint8_t i = 0; i < RUNNING_AVERAGE_DEPTH; i++) {
		buffer_x[i] = 0;
		buffer_y[i] = 0;
		buffer_z[i] = 0;
	}
}

void apply_running_average(const struct accel_data *input, struct accel_data *output)
{
	if (input == NULL || output == NULL) {
		return;
	}

	/* Add new sample to circular buffers */
	buffer_x[buffer_index] = input->x;
	buffer_y[buffer_index] = input->y;
	buffer_z[buffer_index] = input->z;

	/* Update index and count */
	buffer_index = (buffer_index + 1) % RUNNING_AVERAGE_DEPTH;
	if (buffer_count < RUNNING_AVERAGE_DEPTH) {
		buffer_count++;
	}

	/* Calculate averages */
	int32_t sum_x = 0, sum_y = 0, sum_z = 0;
	for (uint8_t i = 0; i < buffer_count; i++) {
		sum_x += buffer_x[i];
		sum_y += buffer_y[i];
		sum_z += buffer_z[i];
	}

	/* Compute average and store in output */
	output->x = (int16_t)(sum_x / buffer_count);
	output->y = (int16_t)(sum_y / buffer_count);
	output->z = (int16_t)(sum_z / buffer_count);
}

#endif /* ENABLE_RUNNING_AVERAGE */

/* ========== MOTION CONVERSION FUNCTIONS ========== */

int16_t convert_to_milli_g(double m_s2)
{
	/* Convert m/s² to milli-g: (m/s² / 9.81) * 1000 */
	double milli_g = (m_s2 / GRAVITY) * 1000.0;
	
	/* Clamp to int16_t range */
	if (milli_g > INT16_MAX_VAL) {
		return INT16_MAX_VAL;
	} else if (milli_g < INT16_MIN_VAL) {
		return INT16_MIN_VAL;
	}
	
	return (int16_t)milli_g;
}

void convert_accel_to_milli_g(double x, double y, double z, struct accel_data *data)
{
	if (data == NULL) {
		return;
	}
	
	data->x = convert_to_milli_g(x);
	data->y = convert_to_milli_g(y);
	data->z = convert_to_milli_g(z);
}

double calculate_magnitude(double x, double y, double z)
{
	return sqrt(x*x + y*y + z*z);
}

bool detect_motion(double x, double y, double z)
{
	double magnitude = calculate_magnitude(x, y, z);
	
	/* Detect motion when magnitude exceeds threshold */
	return magnitude > MOTION_THRESHOLD;
}

bool accel_data_changed(const struct accel_data *current, const struct accel_data *previous)
{
	if (current == NULL || previous == NULL) {
		return false;
	}
	
	return (current->x != previous->x ||
		current->y != previous->y ||
		current->z != previous->z);
}

bool detect_movement_threshold(const struct accel_data *current,
                                const struct accel_data *previous,
                                int16_t threshold_milli_g)
{
	if (current == NULL || previous == NULL) {
		return false;
	}
	
	/* Calculate absolute differences for each axis */
	int16_t dx = current->x - previous->x;
	int16_t dy = current->y - previous->y;
	int16_t dz = current->z - previous->z;
	
	/* Make absolute (handle negative values) */
	if (dx < 0) dx = -dx;
	if (dy < 0) dy = -dy;
	if (dz < 0) dz = -dz;
	
	/* Check if any axis exceeded threshold */
	return (dx > threshold_milli_g || 
	        dy > threshold_milli_g || 
	        dz > threshold_milli_g);
}
```

## src/motion_logic.h
```c
/*
 * Copyright (c) 2026 GuitarAcc Project
 * SPDX-License-Identifier: Apache-2.0
 */

#ifndef MOTION_LOGIC_H
#define MOTION_LOGIC_H

#include <stdint.h>
#include <stdbool.h>

/* Acceleration data structure: X, Y, Z in milli-g */
struct accel_data {
	int16_t x;  /* X-axis in milli-g */
	int16_t y;  /* Y-axis in milli-g */
	int16_t z;  /* Z-axis in milli-g */
} __attribute__((packed));

/* Motion detection configuration */
#define MOTION_THRESHOLD 0.5     /* m/s² threshold for motion detection */

/* Enable/disable running average filter (define to enable) */
#define ENABLE_RUNNING_AVERAGE 1

/* Running average depth (adjustable 3-10) */
#define RUNNING_AVERAGE_DEPTH 5

/* Spike limiter configuration */
#define SPIKE_LIMIT_MILLI_G 500  /* Maximum allowed change per sample (0.5g) */

/**
 * @brief Initialize spike limiter
 * 
 * Sets the initial reference values for spike detection. Call this
 * before using apply_spike_limiter().
 * 
 * @param initial Initial acceleration data
 */
void spike_limiter_init(const struct accel_data *initial);

/**
 * @brief Apply spike limiter to acceleration data
 * 
 * Limits the change in acceleration between samples to prevent
 * sudden spikes from noise or sensor errors. Each axis is independently
 * limited to SPIKE_LIMIT_MILLI_G change per sample.
 * 
 * @param raw Raw acceleration data from sensor
 * @param limited Output limited acceleration data
 */
void apply_spike_limiter(const struct accel_data *raw, struct accel_data *limited);

/**
 * @brief Initialize running average filter
 * 
 * Resets the circular buffers and state for the running average filter.
 * Must be called before using apply_running_average().
 */
void running_average_init(void);

/**
 * @brief Apply running average filter
 * 
 * Applies a running average filter to smooth accelerometer data.
 * The depth is configurable via RUNNING_AVERAGE_DEPTH (3-10 samples).
 * Uses separate circular buffers for each axis.
 * 
 * @param input Input acceleration data
 * @param output Output smoothed acceleration data
 */
void apply_running_average(const struct accel_data *input, struct accel_data *output);

/**
 * @brief Convert acceleration from m/s² to milli-g
 * 
 * Converts SI units (meters per second squared) to milli-g units
 * where 1g = 9.81 m/s². Result is clamped to int16_t range.
 * 
 * @param m_s2 Acceleration in m/s²
 * @return Acceleration in milli-g (±32767 range)
 */
int16_t convert_to_milli_g(double m_s2);

/**
 * @brief Convert XYZ acceleration from m/s² to milli-g
 * 
 * Converts all three axes from SI units to milli-g and stores
 * in the provided accel_data structure.
 * 
 * @param x X-axis acceleration in m/s²
 * @param y Y-axis acceleration in m/s²
 * @param z Z-axis acceleration in m/s²
 * @param data Output structure to store converted values
 */
void convert_accel_to_milli_g(double x, double y, double z, struct accel_data *data);

/**
 * @brief Calculate magnitude of 3D acceleration vector
 * 
 * Computes the Euclidean magnitude: sqrt(x² + y² + z²)
 * 
 * @param x X-axis acceleration in m/s²
 * @param y Y-axis acceleration in m/s²
 * @param z Z-axis acceleration in m/s²
 * @return Magnitude in m/s²
 */
double calculate_magnitude(double x, double y, double z);

/**
 * @brief Detect if motion exceeds threshold
 * 
 * Detects motion by measuring deviation from 1g gravity (9.81 m/s²).
 * If the magnitude differs from gravity by more than MOTION_THRESHOLD,
 * motion is detected.
 * 
 * @param x X-axis acceleration in m/s²
 * @param y Y-axis acceleration in m/s²
 * @param z Z-axis acceleration in m/s²
 * @return true if motion detected, false otherwise
 */
bool detect_motion(double x, double y, double z);

/**
 * @brief Compare two acceleration data structures
 * 
 * Checks if any axis (x, y, or z) differs between current and previous data.
 * Used to avoid sending redundant BLE notifications.
 * 
 * @param current Current acceleration data
 * @param previous Previous acceleration data
 * @return true if data changed, false if unchanged
 */
bool accel_data_changed(const struct accel_data *current, const struct accel_data *previous);

/**
 * @brief Detect movement exceeding threshold
 * 
 * Checks if acceleration has changed by more than the specified threshold
 * on any axis. Useful for detecting significant motion while filtering out
 * noise and minor vibrations.
 * 
 * @param current Current acceleration data in milli-g
 * @param previous Previous acceleration data in milli-g
 * @param threshold_milli_g Minimum change in milli-g to detect (e.g., 50 for 0.05g)
 * @return true if any axis changed by more than threshold, false otherwise
 */
bool detect_movement_threshold(const struct accel_data *current,
                                const struct accel_data *previous,
                                int16_t threshold_milli_g);

#endif /* MOTION_LOGIC_H */
```
